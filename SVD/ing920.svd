# ing920 register map
Vendor: INGChips; Series: ing920xx; File version: 1.0
CPU: CM3 r2p1, little endian, no MPU, no FPU, 2 interrupt priority bits
Registers are 32-bit, read-write, reset 0x0 unless marked. A register's access mark holds for its fields unless they carry their own. Offsets are from the block's base; [hi:lo] are bit positions; {n}, {i} and the like mark numbered series.

## aon2_ctrl
Base 0x40100000
0x00 power_seq_signal_ctrl0 — reg description:
  [31:0] reg_power_seq_signal_ctrl0 — reg description
0x04 power_seq_signal_ctrl1 — reg description:
  [31:0] reg_power_seq_signal_ctrl1 — reg description
0x08 power_seq_dly_ctrl0 — reg description:
  [31:0] reg_power_seq_dly_ctrl0 — reg description
0x0C power_seq_dly_ctrl1 — reg description:
  [31:0] reg_power_seq_dly_ctrl1 — reg description
0x10 TBCU_CTRL — reg description:
  [31:0] reg_TBCU_CTRL — reg description
0x14 LLE_TBCU_LOCK_BASETSCNT_LSB — reg description:
  [31:0] reg_LLE_TBCU_LOCK_BASETSCNT_LSB — reg description
0x18 LLE_TBCU_LOCK_BASETSCNT_HSB — reg description:
  [31:0] reg_LLE_TBCU_LOCK_BASETSCNT_HSB — reg description
0x1C LLE_TBCU_LOCK_SUBTSCNT — reg description:
  [31:0] reg_LLE_TBCU_LOCK_SUBTSCNT — reg description
0x20 LLE_TBCU_SHORT_TIME — reg description:
  [31:0] reg_LLE_TBCU_SHORT_TIME — reg description
0x24 LLE_TBCU_US_TIME_L — reg description:
  [31:0] reg_LLE_TBCU_US_TIME_L — reg description
0x28 LLE_TBCU_US_TIME_H — reg description:
  [31:0] reg_LLE_TBCU_US_TIME_H — reg description
0x2C pwr_ctrl0 — reg description:
  [31:0] reg_pwr_ctrl0 — reg description
0x30 aon1_reg4 — reg description:
  [31:0] reg_aon1_reg4 — reg description
{0x1C+4i} aon1_reg{i} (i=6..10) — reg description:
  [31:0] reg_aon1_reg{i} — reg description
{0x1C+4i} aon1_reg_rd{i} (i=11..13) — reg description:
  [31:0] reg_aon1_reg_rd{i} — reg description
0x54 pwr_ctrl_status0 — reg description:
  [31:0] reg_pwr_ctrl_status0 — reg description
0x58 sys_wakeup_pol0 — reg description:
  [31:0] reg_sys_wakeup_pol0 — reg description
0x5C sys_wakeup_pol1 — reg description:
  [31:0] reg_sys_wakeup_pol1 — reg description
0x60 sys_wakeup_en0 — reg description:
  [31:0] reg_sys_wakeup_en0 — reg description
0x64 sys_wakeup_en1 — reg description:
  [31:0] reg_sys_wakeup_en1 — reg description
{0x68+4i} sys_wakeup_mode{i} (i=0..2) — reg description:
  [31:0] reg_sys_wakeup_mode{i} — reg description
0x74 aon2_wk_source — reg description:
  [31:0] reg_aon2_wk_source — reg description
0x78 aon2_io_aon_i_low — reg description:
  [31:0] reg_aon2_io_aon_i_low — reg description
0x7C aon2_io_aon_i_high — reg description:
  [31:0] reg_aon2_io_aon_i_high — reg description
0x84 aon2_sleep_ctrl_1 — reg description:
  [31:0] reg_aon2_sleep_ctrl_1 — reg description
0x88 aon2_sleep_cnt_rd — reg description:
  [31:0] reg_aon2_sleep_cnt_rd — reg description

## qdec
Base 0x40009000
{0x0+0x40*i} channel{i}_ctrl (i=0..2) — reg description:
  [31:0] reg_channel{i}_ctrl — reg description
{0x4+0x40*i} channel{i}_mode (i=0..2) — reg description:
  [31:0] reg_channel{i}_mode — reg description
{0x8+0x40*i} channel{i}_step (i=0..2) — reg description:
  [31:0] reg_channel{i}_step — reg description
{0xC+0x40*i} channel{i}_read_rab (i=0..2) — reg description:
  [31:0] reg_channel{i}_read_rab — reg description
{0x10+0x40*i} channel{i}_read_tc (i=0..2) — reg description:
  [31:0] reg_channel{i}_read_tc — reg description
{0x14+0x40*i} channel{i}write_a (i=0..2) — reg description:
  [31:0] reg_channel{i}write_a — reg description
{0x18+0x40*i} channel{i}write_b (i=0..2) — reg description:
  [31:0] reg_channel{i}write_b — reg description
{0x1C+0x40*i} channel{i}write_c (i=0..2) — reg description:
  [31:0] reg_channel{i}write_c — reg description
{0x20+0x40*i} channel{i}tiob0_rd (i=0..2) — reg description:
  [31:0] reg_channel{i}tiob0_rd — reg description
{0x24+0x40*i} channel{i}int_en (i=0..2) — reg description:
  [31:0] reg_channel{i}int_en — reg description
{0x28+0x40*i} channel{i}int_dis (i=0..2) — reg description:
  [31:0] reg_channel{i}int_dis — reg description
{0x2C+0x40*i} channel{i}int_rd (i=0..2) — reg description:
  [31:0] reg_channel{i}int_rd — reg description
0xC0 bcr — reg description:
  [31:0] reg_bcr — reg description
0xC4 bmr — reg description:
  [31:0] reg_bmr — reg description
0xC8 qdec_inten — reg description:
  [31:0] reg_qdec_inten — reg description
0xCC qdec_intdis — reg description:
  [31:0] reg_qdec_intdis — reg description
0xD0 qdec_inten_rd — reg description:
  [31:0] reg_qdec_inten_rd — reg description
0xD4 qdec_status_sel — reg description:
  [31:0] reg_qdec_status_sel — reg description
0xD8 pwm_fault — reg description:
  [31:0] reg_pwm_fault — reg description
0xE0 dummy — reg description:
  [31:0] reg_dummy — reg description
0xE4 wpmode — reg description:
  [31:0] reg_wpmode — reg description
0xEC addrsize — reg description:
  [31:0] reg_addrsize — reg description
0xF0 name1 — reg description:
  [31:0] reg_name1 — reg description
0xF4 name2 — reg description:
  [31:0] reg_name2 — reg description
0xF8 FEATURES — reg description:
  [31:0] reg_FEATURES — reg description

## ptec
Base 0x40019000
{0x0+4i} REG_TASKS_CHG{i}_EN (i=0..3) — reg description:
  [31:0] reg_REG_TASKS_CHG{i}_EN — reg description
{0x10+4i} REG_TASKS_CHG{i}_DIS (i=0..3) — reg description:
  [31:0] reg_REG_TASKS_CHG{i}_DIS — reg description
{0x20+4i} REG_SUB_TASKS_CHG{i}_EN (i=0..3) — reg description:
  [31:0] reg_REG_SUB_TASKS_CHG{i}_EN — reg description
{0x30+4i} REG_SUB_TASKS_CHG{i}_DIS (i=0..3) — reg description:
  [31:0] reg_REG_SUB_TASKS_CHG{i}_DIS — reg description
0x100 REG_CHEN — reg description:
  [31:0] reg_REG_CHEN — reg description
0x104 REG_CHEN_set — reg description:
  [31:0] reg_REG_CHEN_set — reg description
0x108 REG_CHEN_clr — reg description:
  [31:0] reg_REG_CHEN_clr — reg description
{0x200+4i} REG_CHG{i}_MAP (i=0..3) — reg description:
  [31:0] reg_REG_CHG{i}_MAP — reg description

## ingasdm
Base 0x4001A000
0x00 ASDM_CTRL_ADDR — reg description:
  [31:0] reg_ASDM_CTRL_ADDR — reg description
0x04 ASDM_SR_ADDR — reg description:
  [31:0] reg_ASDM_SR_ADDR — reg description
0x08 ASDM_CLR_ADDR — reg description:
  [31:0] reg_ASDM_CLR_ADDR — reg description
0x0C ASDM_MUTE_CTRL_ADDR — reg description:
  [31:0] reg_ASDM_MUTE_CTRL_ADDR — reg description
0x10 ASDM_VOL_CTRL_ADDR — reg description:
  [31:0] reg_ASDM_VOL_CTRL_ADDR — reg description
0x14 ASDM_DOUT_ADDR — reg description:
  [31:0] reg_ASDM_DOUT_ADDR — reg description
0x18 ASDM_HPF_COEF_ADDR — reg description:
  [31:0] reg_ASDM_HPF_COEF_ADDR — reg description
0x1C ASDM_RX_ERROR_CTRL_ADDR — reg description:
  [31:0] reg_ASDM_RX_ERROR_CTRL_ADDR — reg description
{0x20+4i} ASDM_AGC_CTRL{i}_ADDR (i=0..2) — reg description:
  [31:0] reg_ASDM_AGC_CTRL{i}_ADDR — reg description
0x2C ASDM_AGC_ST_ADDR — reg description:
  [31:0] reg_ASDM_AGC_ST_ADDR — reg description
0x30 ASDM_ANA_CTRL0_ADDR — reg description:
  [31:0] reg_ASDM_ANA_CTRL0_ADDR — reg description
0x34 ASDM_PGA_EN_IBIAS_ADDR — reg description:
  [31:0] reg_ASDM_PGA_EN_IBIAS_ADDR — reg description
0x3C PGA_L_CTRL_ADDR — reg description:
  [31:0] reg_PGA_L_CTRL_ADDR — reg description
0x40 PGA_L_VOL_CTRL_ADDR — reg description:
  [31:0] reg_PGA_L_VOL_CTRL_ADDR — reg description
0x44 MICBIAS_CTRL_ADDR — reg description:
  [31:0] reg_MICBIAS_CTRL_ADDR — reg description
0x48 CKGT_CTRL_ADDR — reg description:
  [31:0] reg_CKGT_CTRL_ADDR — reg description
0x4C FIFO_ADDR — reg description:
  [31:0] reg_FIFO_ADDR — reg description
