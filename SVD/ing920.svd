# ing920 register map
Vendor: INGChips; Series: ing920xx; File version: 1.0
CPU: CM3 r2p1, little endian, no MPU, no FPU, 2 interrupt priority bits
Registers are 32-bit, read-write, reset 0x0 unless marked. A register's access mark holds for its fields unless they carry their own. Offsets are from the block's base; [hi:lo] are bit positions; {n}, {i} and the like mark numbered series.

## key_scanner
Base 0x4000A000
0x00 key_scanner_ctrl0 — reg description:
  [31:0] reg_key_scanner_ctrl0 — reg description
0x04 key_scanner_ctrl1 — reg description:
  [31:0] reg_key_scanner_ctrl1 — reg description
0x08 key_row_mask_ctrl — reg description:
  [31:0] reg_key_row_mask_ctrl — reg description
0x0C key_col_mask_ctrl — reg description:
  [31:0] reg_key_col_mask_ctrl — reg description
0x10 key_int_en — reg description:
  [31:0] reg_key_int_en — reg description
0x14 key_int — reg description:
  [31:0] reg_key_int — reg description
0x18 fifo_status — reg description:
  [31:0] reg_fifo_status — reg description
0x1C key_data — reg description:
  [31:0] reg_key_data — reg description
0x20 key_trig — reg description:
  [31:0] reg_key_trig — reg description
0x24 key_err_cfg — reg description:
  [31:0] reg_key_err_cfg — reg description
0x28 key_debouncd_cfg0 — reg description:
  [31:0] reg_key_debouncd_cfg0 — reg description
0x2C key_debouncd_cfg1 — reg description:
  [31:0] reg_key_debouncd_cfg1 — reg description

## pwm
Base 0x40005000
{0x0+0x20*i} c{i}_pwm_ctrl0 (i=0..2) — reg description:
  [31:0] reg_c{i}_pwm_ctrl0 — reg description
{0x4+0x20*i} c{i}_pwm_ctrl1 (i=0..2) — reg description:
  [31:0] reg_c{i}_pwm_ctrl1 — reg description
{0x10+0x20*i} c{i}_pwm_ctrl2 (i=0..2) — reg description:
  [31:0] reg_c{i}_pwm_ctrl2 — reg description
{0x14+0x20*i} c{i}_pwm_ctrl3 (i=0..2) — reg description:
  [31:0] reg_c{i}_pwm_ctrl3 — reg description
{0x18+0x20*i} c{i}_pwm_ctrl4 (i=0..2) — reg description:
  [31:0] reg_c{i}_pwm_ctrl4 — reg description
{0x1C+0x20*i} c{i}_pwm_ctrl5 (i=0..2) — reg description:
  [31:0] reg_c{i}_pwm_ctrl5 — reg description
{0x60+0x10*i} c{i}_cap_ctrl0 (i=0..2) — reg description:
  [31:0] reg_c{i}_cap_ctrl0 — reg description
{0x64+0x10*i} c{i}_cap_ctrl1 (i=0..2) — reg description:
  [31:0] reg_c{i}_cap_ctrl1 — reg description
0x90 cap_cnt_en — reg description:
  [31:0] reg_cap_cnt_en — reg description
0x94 cap_cnt — reg description:
  [31:0] reg_cap_cnt — reg description
{0x100+0x10*i} c{i}_step (i=0..2) — reg description:
  [31:0] reg_c{i}_step — reg description
{0x104+0x10*i} c{i}_step1 (i=0..2) — reg description:
  [31:0] reg_c{i}_step1 — reg description

## sadc
Base 0x4000F000
{0x0+4i} sadc_cfg{i} (i=0..2) — reg description:
  [31:0] reg_sadc_cfg{i} — reg description
0x0C sadc_data — reg description:
  [31:0] reg_sadc_data — reg description
0x10 sadc_status0 — reg description:
  [31:0] reg_sadc_status0 — reg description
0x14 sadc_cfg3 — reg description:
  [31:0] reg_sadc_cfg3 — reg description
0x30 sadc_int_mask — reg description:
  [31:0] reg_sadc_int_mask — reg description
0x34 sadc_int — reg description:
  [31:0] reg_sadc_int — reg description

## aon1_ctrl
Base 0x40102000
0x00 aon1_reg0 — reg description:
  [31:0] reg_aon1_reg0 — reg description
0x04 aon1_reg1 — reg description:
  [31:0] reg_aon1_reg1 — reg description
0x10 aon1_reg4 — reg description:
  [31:0] reg_aon1_reg4 — reg description
0x14 aon1_boot — reg description:
  [31:0] reg_aon1_boot — reg description
0x18 aon1_reg5 — reg description:
  [31:0] reg_aon1_reg5 — reg description
0x1C aon1_cnt_int — reg description:
  [31:0] reg_aon1_cnt_int — reg description
0x20 aon1_dly_ctrl0 — reg description:
  [31:0] reg_aon1_dly_ctrl0 — reg description
0x24 aon1_dly_ctrl1 — reg description:
  [31:0] reg_aon1_dly_ctrl1 — reg description
0x28 pll_ctrl_reg — reg description:
  [31:0] reg_pll_ctrl_reg — reg description
0x2C patch_cfg — reg description:
  [31:0] reg_patch_cfg — reg description
{0x30+4i} PMU_CFG{i} (i=0..3) — reg description:
  [31:0] reg_PMU_CFG{i} — reg description
