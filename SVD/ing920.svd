# ing920 register map
Vendor: INGChips; Series: ing920xx; File version: 1.0
CPU: CM3 r2p1, little endian, no MPU, no FPU, 2 interrupt priority bits
Registers are 32-bit, read-write, reset 0x0 unless marked. A register's access mark holds for its fields unless they carry their own. Offsets are from the block's base; [hi:lo] are bit positions; {n}, {i} and the like mark numbered series.

## TRNG
Base 0x40007000
0x00 TRNG_CONFIG — reg description:
  [31:0] reg_TRNG_CONFIG — reg description
0x04 TRNG_BIT_SEL — reg description:
  [31:0] reg_TRNG_BIT_SEL — reg description
0x08 TRNG_DATA_CTRL — reg description:
  [31:0] reg_TRNG_DATA_CTRL — reg description
0x0C TRNG_INT_STATUS — reg description:
  [31:0] reg_TRNG_INT_STATUS — reg description
0x10 TRNG_DATA — reg description:
  [31:0] reg_TRNG_DATA — reg description

## DMA
Base 0x4000C000
0x00 IdRev — reg description:
  [31:0] reg_IdRev — reg description
0x04 IdMisc — reg description:
  [31:0] reg_IdMisc — reg description
0x10 DMACfg — reg description:
  [31:0] reg_DMACfg — reg description
0x20 DMACtrl — reg description:
  [31:0] reg_DMACtrl — reg description
0x24 ChAbort — reg description:
  [31:0] reg_ChAbort — reg description
0x30 IntStatus — reg description:
  [31:0] reg_IntStatus — reg description
0x34 ChEN — reg description:
  [31:0] reg_ChEN — reg description
{0x40+0x20*i} Ch{i}Ctrl (i=0..7) — reg description:
  [31:0] reg_Ch{i}Ctrl — reg description
{0x44+0x20*i} Ch{i}TranSize (i=0..7) — reg description:
  [31:0] reg_Ch{i}TranSize — reg description
{0x48+0x20*i} Ch{i}SrcAddr (i=0..7) — reg description:
  [31:0] reg_Ch{i}SrcAddr — reg description
{0x50+0x20*i} Ch{i}DstAddr (i=0..7) — reg description:
  [31:0] reg_Ch{i}DstAddr — reg description
{0x58+0x20*i} Ch{i}LLPointer (i=0..7) — reg description:
  [31:0] reg_Ch{i}LLPointer — reg description

## QSPI
Base 0x40160000
Same registers: APBSPI 0x4000E000
0x00 IdRev — reg description:
  [31:0] reg_IdRev — reg description
0x10 TransFmt — reg description:
  [31:0] reg_TransFmt — reg description
0x14 DirectIO — reg description:
  [31:0] reg_DirectIO — reg description
0x20 TransCtrl — reg description:
  [31:0] reg_TransCtrl — reg description
0x24 Cmd — reg description:
  [31:0] reg_Cmd — reg description
0x28 Addr — reg description:
  [31:0] reg_Addr — reg description
0x2C Data — reg description:
  [31:0] reg_Data — reg description
0x30 Ctrl — reg description:
  [31:0] reg_Ctrl — reg description
0x34 Status — reg description:
  [31:0] reg_Status — reg description
0x38 IntrEn — reg description:
  [31:0] reg_IntrEn — reg description
0x3C IntrSt — reg description:
  [31:0] reg_IntrSt — reg description
0x40 Timing — reg description:
  [31:0] reg_Timing — reg description
0x50 MemCtrl — reg description:
  [31:0] reg_MemCtrl — reg description
0x60 SlvSt — reg description:
  [31:0] reg_SlvSt — reg description
0x64 SlvDataCnt — reg description:
  [31:0] reg_SlvDataCnt — reg description
0x7C Config — reg description:
  [31:0] reg_Config — reg description

## I2S
Base 0x40010000
0x00 I2S_MODE_CONFIG — reg description:
  [31:0] reg_I2S_MODE_CONFIG — reg description
0x04 I2S_CLK_DIV — reg description:
  [31:0] reg_I2S_CLK_DIV — reg description
0x08 I2S_CONFIG — reg description:
  [31:0] reg_I2S_CONFIG — reg description
0x0C I2S_TX — reg description:
  [31:0] reg_I2S_TX — reg description
0x10 I2S_RX — reg description:
  [31:0] reg_I2S_RX — reg description
0x14 I2S_TRIG — reg description:
  [31:0] reg_I2S_TRIG — reg description
0x18 I2S_STATUS — reg description:
  [31:0] reg_I2S_STATUS — reg description
0x1C I2S_FIFO_STATUS — reg description:
  [31:0] reg_I2S_FIFO_STATUS — reg description

## UART0
Base 0x40011000
Same registers: UART1 0x40012000
0x00 UARTDR — reg description:
  [31:0] reg_UARTDR — reg description
0x04 UARTRSR_UARTECR — reg description:
  [31:0] reg_UARTRSR_UARTECR — reg description
0x18 UARTFR — reg description:
  [31:0] reg_UARTFR — reg description
0x20 UARTILPR — reg description:
  [31:0] reg_UARTILPR — reg description
0x24 UARTIBRD — reg description:
  [31:0] reg_UARTIBRD — reg description
0x28 UARTFBRD — reg description:
  [31:0] reg_UARTFBRD — reg description
0x2C UARTLCR_H — reg description:
  [31:0] reg_UARTLCR_H — reg description
0x30 UARTCR — reg description:
  [31:0] reg_UARTCR — reg description
0x34 UARTIFLS — reg description:
  [31:0] reg_UARTIFLS — reg description
0x38 UARTIMSC — reg description:
  [31:0] reg_UARTIMSC — reg description
0x3C UARTRIS — reg description:
  [31:0] reg_UARTRIS — reg description
0x40 UARTMIS — reg description:
  [31:0] reg_UARTMIS — reg description
0x44 UARTICR — reg description:
  [31:0] reg_UARTICR — reg description
0x48 UARTDMACR — reg description:
  [31:0] reg_UARTDMACR — reg description
{0xFE0+4i} UARTPeriphID{i} (i=0..3) — reg description:
  [31:0] reg_UARTPeriphID{i} — reg description
0xFF0 UARTPCellID0 — reg description:
  [31:0] reg_UARTPCellID0 — reg description
0xFF4 UARTPCellID1 — reg description:
  [31:0] reg_UARTPCellID1 — reg description
0xFF8 UARTPCellD2 — reg description:
  [31:0] reg_UARTPCellD2 — reg description
0xFFC UARTPCellID3 — reg description:
  [31:0] reg_UARTPCellID3 — reg description
