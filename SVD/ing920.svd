# ing920 register map
Vendor: INGChips; Series: ing920xx; File version: 1.0
CPU: CM3 r2p1, little endian, no MPU, no FPU, 2 interrupt priority bits
Registers are 32-bit, read-write, reset 0x0 unless marked. A register's access mark holds for its fields unless they carry their own. Offsets are from the block's base; [hi:lo] are bit positions; {n}, {i} and the like mark numbered series.

## sys_ctrl
Base 0x40000000
{0x0+4i} cgu_cfg{i} (i=0..7) — reg description:
  [31:0] reg_cgu_cfg{i} — reg description
0x20 rstu_cfg0 — reg description:
  [31:0] reg_rstu_cfg0 — reg description
0x24 rstu_cfg1 — reg description:
  [31:0] reg_rstu_cfg1 — reg description
0x28 sys_ctrl_0 — reg description:
  [31:0] reg_sys_ctrl_0 — reg description
0x2C cgu_cfg8 — reg description:
  [31:0] reg_cgu_cfg8 — reg description
0x30 dma_ctrl_0 — reg description:
  [31:0] reg_dma_ctrl_0 — reg description
0x34 dma_ctrl_1 — reg description:
  [31:0] reg_dma_ctrl_1 — reg description
0x40 pll_ctrl_reg — reg description:
  [31:0] reg_pll_ctrl_reg — reg description
0x44 ana_ctrl_reg — reg description:
  [31:0] reg_ana_ctrl_reg — reg description
0x54 qdec_cfg — reg description:
  [31:0] reg_qdec_cfg — reg description
0x60 sys_io_status — reg description:
  [31:0] reg_sys_io_status — reg description
0x64 sys_io_wk_source — reg description:
  [31:0] reg_sys_io_wk_source — reg description
0x68 sys_io_in_status — reg description:
  [31:0] reg_sys_io_in_status — reg description
0x70 p_cap_ctrl — reg description:
  [31:0] reg_p_cap_ctrl — reg description
0x74 sys_eco_reg — reg description:
  [31:0] reg_sys_eco_reg — reg description
0x7C sys_lock — reg description:
  [31:0] reg_sys_lock — reg description
0x80 usb_cfg — reg description:
  [31:0] reg_usb_cfg — reg description
0x160 chip_id — reg description:
  [31:0] reg_chip_id — reg description
0x164 rf_ctrl0 — reg description:
  [31:0] reg_rf_ctrl0 — reg description
0x168 rf_ctrl1 — reg description:
  [31:0] reg_rf_ctrl1 — reg description
0x170 mem_cfg_reg0 — reg description:
  [31:0] reg_mem_cfg_reg0 — reg description
0x174 mem_cfg_reg1 — reg description:
  [31:0] reg_mem_cfg_reg1 — reg description
0x178 remap_cfg — reg description:
  [31:0] reg_remap_cfg — reg description
0x190 dbg_cfg_reg — reg description:
  [31:0] reg_dbg_cfg_reg — reg description
0x1C4 io_vdd_ok — reg description:
  [31:0] reg_io_vdd_ok — reg description
0x1C8 vld_clk_rd — reg description:
  [31:0] reg_vld_clk_rd — reg description
0x1CC vld_clk_rd1 — reg description:
  [31:0] reg_vld_clk_rd1 — reg description
{0x1D0+4i} reg_rd_io{i} (i=0..3) — reg description:
  [31:0] reg_reg_rd_io{i} — reg description
0x1E0 clk_out_func_cfg — reg description:
  [31:0] reg_clk_out_func_cfg — reg description
{0x1F0+4i} REG_GPIOTE_CONFIG{i} (i=0..7) — reg description:
  [31:0] reg_REG_GPIOTE_CONFIG{i} — reg description
0x210 REG_DLY_CHAIN_EN — reg description:
  [31:0] reg_REG_DLY_CHAIN_EN — reg description
0x214 REG_DLY_CHAIN_CNT — reg description:
  [31:0] reg_REG_DLY_CHAIN_CNT — reg description
0x218 REG_RSTNSRC_DET — reg description:
  [31:0] reg_REG_RSTNSRC_DET — reg description
0x21C cgu_cfg9 — reg description:
  [31:0] reg_cgu_cfg9 — reg description
0x220 pwm_timer_b_inv — reg description:
  [31:0] reg_pwm_timer_b_inv — reg description
0x224 lle_tbcu_sleep_inc — reg description:
  [31:0] reg_lle_tbcu_sleep_inc — reg description
0x230 RC16M_CFG — reg description:
  [31:0] reg_RC16M_CFG — reg description
0x234 PMU_STATUS — reg description:
  [31:0] reg_PMU_STATUS — reg description

## io_mux_ctrl
Base 0x40006000
{0x0+4i} io_mux_out_ctrl{i} (i=0..8) — reg description:
  [31:0] reg_io_mux_out_ctrl{i} — reg description
{0x40+4i} io_mux_in_ctrl{i} (i=0..7) — reg description:
  [31:0] reg_io_mux_in_ctrl{i} — reg description
{0x40+4i} io_mux_in_ctrl{i} (i=9..11) — reg description:
  [31:0] reg_io_mux_in_ctrl{i} — reg description
0x80 io_pe_ctrl0 — reg description:
  [31:0] reg_io_pe_ctrl0 — reg description
0x84 io_pe_ctrl1 — reg description:
  [31:0] reg_io_pe_ctrl1 — reg description
0x88 io_ps_ctrl0 — reg description:
  [31:0] reg_io_ps_ctrl0 — reg description
0x8C io_ps_ctrl1 — reg description:
  [31:0] reg_io_ps_ctrl1 — reg description
0x90 io_pu_sel_ctrl0 — reg description:
  [31:0] reg_io_pu_sel_ctrl0 — reg description
0x94 io_pu_sel_ctrl1 — reg description:
  [31:0] reg_io_pu_sel_ctrl1 — reg description
0x100 io_mux_is_ctrl0 — reg description:
  [31:0] reg_io_mux_is_ctrl0 — reg description
0x104 io_mux_is_ctrl1 — reg description:
  [31:0] reg_io_mux_is_ctrl1 — reg description
{0x108+4i} io_mux_dr_ctrl{i} (i=0..2) — reg description:
  [31:0] reg_io_mux_dr_ctrl{i} — reg description
0x114 io_spiflash_cfg0 — reg description:
  [31:0] reg_io_spiflash_cfg0 — reg description
0x118 io_spiflash_cfg1 — reg description:
  [31:0] reg_io_spiflash_cfg1 — reg description
