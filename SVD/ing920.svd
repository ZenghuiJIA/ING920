# ing920 register map
Vendor: INGChips; Series: ing920xx; File version: 1.0
CPU: CM3 r2p1, little endian, no MPU, no FPU, 2 interrupt priority bits
Registers are 32-bit, read-write, reset 0x0 unless marked. A register's access mark holds for its fields unless they carry their own. Offsets are from the block's base; [hi:lo] are bit positions; {n}, {i} and the like mark numbered series.

## I2C
Base 0x40013000
0x00 IdRev — reg description:
  [31:0] reg_IdRev — reg description
0x10 Cfg — reg description:
  [31:0] reg_Cfg — reg description
0x14 IntEn — reg description:
  [31:0] reg_IntEn — reg description
0x18 Status — reg description:
  [31:0] reg_Status — reg description
0x1C Addr — reg description:
  [31:0] reg_Addr — reg description
0x20 Data — reg description:
  [31:0] reg_Data — reg description
0x24 Ctrl — reg description:
  [31:0] reg_Ctrl — reg description
0x28 Cmd — reg description:
  [31:0] reg_Cmd — reg description
0x2C Setup — reg description:
  [31:0] reg_Setup — reg description
0x30 TPM — reg description:
  [31:0] reg_TPM — reg description

## GPIO0
Base 0x40015000
Same registers: GPIO1 0x40016000
0x00 IdRev — reg description:
  [31:0] reg_IdRev — reg description
0x10 Cfg — reg description:
  [31:0] reg_Cfg — reg description
0x20 DataIn — reg description:
  [31:0] reg_DataIn — reg description
0x24 DataOut — reg description:
  [31:0] reg_DataOut — reg description
0x28 ChannelDir — reg description:
  [31:0] reg_ChannelDir — reg description
0x2C DoutClear — reg description:
  [31:0] reg_DoutClear — reg description
0x30 DoutSet — reg description:
  [31:0] reg_DoutSet — reg description
0x34 IOIE — reg description:
  [31:0] reg_IOIE — reg description
0x50 IntrEn — reg description:
  [31:0] reg_IntrEn — reg description
{0x54+4i} IntrMode{i} (i=0..2) — reg description:
  [31:0] reg_IntrMode{i} — reg description
0x64 IntrStatus — reg description:
  [31:0] reg_IntrStatus — reg description
0x70 DeBounceEn — reg description:
  [31:0] reg_DeBounceEn — reg description
0x74 DeBounceCtrl — reg description:
  [31:0] reg_DeBounceCtrl — reg description

## CACHE_CTRL
Base 0x40140000
0x00 enable — reg description:
  [31:0] reg_enable — reg description
{0x0+4i} base_addr{i} (i=1..7) — reg description:
  [31:0] reg_base_addr{i} — reg description
{0x20+4i} remap{i} (i=0..7) — reg description:
  [31:0] reg_remap{i} — reg description
0x40 cache_cfg0 — reg description:
  [31:0] reg_cache_cfg0 — reg description
0x44 bus_sts0 — reg description:
  [31:0] reg_bus_sts0 — reg description
0x48 cache_sts0 — reg description:
  [31:0] reg_cache_sts0 — reg description
{0x50+4i} cmd_cfg{i} (i=0..2) — reg description:
  [31:0] reg_cmd_cfg{i} — reg description
0x60 int_en — reg description:
  [31:0] reg_int_en — reg description
0x64 int_raw — reg description:
  [31:0] reg_int_raw — reg description
0x68 int_mask — reg description:
  [31:0] reg_int_mask — reg description
0x6C int_clr — reg description:
  [31:0] reg_int_clr — reg description
0x70 write_hit_cnt — reg description:
  [31:0] reg_write_hit_cnt — reg description
0x74 write_miss_cnt — reg description:
  [31:0] reg_write_miss_cnt — reg description
0x78 read_hit_cnt — reg description:
  [31:0] reg_read_hit_cnt — reg description
0x7C read_miss_cnt — reg description:
  [31:0] reg_read_miss_cnt — reg description
0x80 hact_cnt — reg description:
  [31:0] reg_hact_cnt — reg description
0x84 hrdy_cnt — reg description:
  [31:0] reg_hrdy_cnt — reg description

## FLASH_SPI_CTRL
Base 0x40150000
0x00 spi_cmd_addr — reg description:
  [31:0] reg_spi_cmd_addr — reg description
0x04 spi_block_size — reg description:
  [31:0] reg_spi_block_size — reg description
0x08 spi_data_fifo — reg description:
  [31:0] reg_spi_data_fifo — reg description
0x0C spi_status — reg description:
  [31:0] reg_spi_status — reg description
0x10 rx_status — reg description:
  [31:0] reg_rx_status — reg description
0x14 spi_config — reg description:
  [31:0] reg_spi_config — reg description
0x18 spi_fifo_control — reg description:
  [31:0] reg_spi_fifo_control — reg description
0x1C spi_cs_size — reg description:
  [31:0] reg_spi_cs_size — reg description
0x20 spi_read_cmd — reg description:
  [31:0] reg_spi_read_cmd — reg description
0x24 spi_nand_config — reg description:
  [31:0] reg_spi_nand_config — reg description
0x28 spi_nand_config2 — reg description:
  [31:0] reg_spi_nand_config2 — reg description
0x2C spi_256_512_flash_config — reg description:
  [31:0] reg_spi_256_512_flash_config — reg description
0x30 spi_128_flash_config — reg description:
  [31:0] reg_spi_128_flash_config — reg description
0x34 timeout_value — reg description:
  [31:0] reg_timeout_value — reg description
0x3C tsus_tres — reg description:
  [31:0] reg_tsus_tres — reg description
0x40 flash_irq — reg description:
  [31:0] reg_flash_irq — reg description
0x44 flash_irq_mask — reg description:
  [31:0] reg_flash_irq_mask — reg description
